## Digilent-Arty-Z7-Linux-BD-v2016.2/build/linux/Kconfig
```kconfig
mainmenu "linux System Configuration"
config SUBSYSTEM_TYPE_LINUX
	bool
	default y

menu "linux Components Selection"
config SUBSYSTEM_COMPONENT_DEVICE__TREE_NAME_DEVICE__TREE__GENERATOR
	bool
	default y

config SUBSYSTEM_COMPONENT_BOOTLOADER_AUTO_FSBL
	bool "First Stage Bootloader"
	select SUBSYSTEM_HARDWARE_AUTO
	help
	  If you select this option, PetaLinux will auto generate the first stage
	  bootloader from HSM template into your <PROJECT>/components/bootloader/
	  directory if it is not there. PetaLinux will also auto generate the HSM
	  BSP for the bootloader everytime you run petalinux-config.
	  If you don't want to use the default bootloader, please DONOT select this
	  option.
	  If you DONOT select this option, petalinux will not generate, config or
	  build your bootloader.
config SUBSYSTEM_COMPONENT_BOOTLOADER_NAME_FS__BOOT
	bool
	default y
	depends on SUBSYSTEM_COMPONENT_BOOTLOADER_AUTO_FSBL && SUBSYSTEM_ARCH_MICROBLAZE
config SUBSYSTEM_COMPONENT_BOOTLOADER_NAME_ZYNQ_FSBL
	bool
	default y
	depends on SUBSYSTEM_COMPONENT_BOOTLOADER_AUTO_FSBL && SUBSYSTEM_ARCH_ARM
config SUBSYSTEM_COMPONENT_BOOTLOADER_AUTO_PS_INIT
	bool "Auto update ps7_init"
	default y
	depends on SUBSYSTEM_COMPONENT_BOOTLOADER_NAME_ZYNQ_FSBL
	help
	  If you select this option, PetaLinux will auto update ps7_init.c/.h files
	  in Zynq fsbl source when running "petalinux-config --get-hw-description".
config SUBSYSTEM_COMPONENT_BOOTLOADER_NAME_ZYNQMP_FSBL
	bool
	default y
	depends on SUBSYSTEM_COMPONENT_BOOTLOADER_AUTO_FSBL && SUBSYSTEM_ARCH_AARCH64
config SUBSYSTEM_COMPONENT_BOOTLOADER_AUTO_PS_INIT
	bool "Auto update psu_init"
	default y
	depends on SUBSYSTEM_COMPONENT_BOOTLOADER_NAME_ZYNQMP_FSBL
	help
	  If you select this option, PetaLinux will auto update psu_init.c/.h files
	  in Zynq fsbl source when running "petalinux-config --get-hw-description".

choice
	prompt "u-boot"
config SUBSYSTEM_COMPONENT_U__BOOT_NAME_U__BOOT__PLNX
	bool "u-boot-plnx"
config SUBSYSTEM_COMPONENT_U__BOOT_NAME_REMOTE
	bool "remote"
config SUBSYSTEM_COMPONENT_U__BOOT_NAME_NONE
	bool "none"
endchoice
menu "Remote u-boot settings"
	depends on SUBSYSTEM_COMPONENT_U__BOOT_NAME_REMOTE
config SUBSYSTEM_COMPONENT_U__BOOT_NAME_REMOTE_DOWNLOAD_PATH
	string "Remote u-boot git URL"
	depends on SUBSYSTEM_COMPONENT_U__BOOT_NAME_REMOTE
config SUBSYSTEM_COMPONENT_U__BOOT_NAME_REMOTE_REFERENCE
	string "Remote  git TAG/Commit ID"
	depends on SUBSYSTEM_COMPONENT_U__BOOT_NAME_REMOTE
	help
	  It will git clone the remote to the specified directory in the project's components
endmenu
if SUBSYSTEM_ARCH_AARCH64
choice
	prompt "arm-trusted-firmware"
config SUBSYSTEM_COMPONENT_ARM__TRUSTED__FIRMWARE_NAME_RONALDO__ATF
	bool "Ronaldo-atf"
config SUBSYSTEM_COMPONENT_ARM__TRUSTED__FIRMWARE_NAME_REMOTE
	bool "remote"
config SUBSYSTEM_COMPONENT_ARM__TRUSTED__FIRMWARE_NAME_NONE
	bool "none"
endchoice
menu "Remote arm-trusted-firmware settings"
	depends on SUBSYSTEM_COMPONENT_ARM__TRUSTED__FIRMWARE_NAME_REMOTE
config SUBSYSTEM_COMPONENT_ARM__TRUSTED__FIRMWARE_NAME_REMOTE_DOWNLOAD_PATH
	string "Remote arm-trusted-firmware git URL"
	depends on SUBSYSTEM_COMPONENT_ARM__TRUSTED__FIRMWARE_NAME_REMOTE
config SUBSYSTEM_COMPONENT_ARM__TRUSTED__FIRMWARE_NAME_REMOTE_REFERENCE
	string "Remote  git TAG/Commit ID"
	depends on SUBSYSTEM_COMPONENT_ARM__TRUSTED__FIRMWARE_NAME_REMOTE
	help
	  It will git clone the remote to the specified directory in the project's components
endmenu
endif
choice
	prompt "kernel"
config SUBSYSTEM_COMPONENT_LINUX__KERNEL_INSTANCE_KERNEL_NAME_XLNX__4___4
	bool "xlnx-4.4"
config SUBSYSTEM_COMPONENT_LINUX__KERNEL_INSTANCE_KERNEL_NAME_REMOTE
	bool "remote"
endchoice
menu "Remote linux-kernel settings"
	depends on SUBSYSTEM_COMPONENT_LINUX__KERNEL_INSTANCE_KERNEL_NAME_REMOTE
config SUBSYSTEM_COMPONENT_LINUX__KERNEL_INSTANCE_KERNEL_NAME_REMOTE_DOWNLOAD_PATH
	string "Remote linux-kernel git URL"
	depends on SUBSYSTEM_COMPONENT_LINUX__KERNEL_INSTANCE_KERNEL_NAME_REMOTE
config SUBSYSTEM_COMPONENT_LINUX__KERNEL_INSTANCE_KERNEL_NAME_REMOTE_REFERENCE
	string "Remote  git TAG/Commit ID"
	depends on SUBSYSTEM_COMPONENT_LINUX__KERNEL_INSTANCE_KERNEL_NAME_REMOTE
	help
	  It will git clone the remote to the specified directory in the project's components
endmenu
choice
	prompt "rootfs"
config SUBSYSTEM_COMPONENT_ROOTFS_NAME_PETALINUX__ROOTFS
	bool "petalinux-rootfs"
endchoice
config SUBSYSTEM_COMPONENT_ROOTFS_PACKAGE_REPO_URL0
	string "rootfs package feed url"
	depends on SUBSYSTEM_COMPONENT_ROOTFS_NAME_PETALINUX__ROOTFS
	default "file:///${PETALINUX}/components/packages-repo/plnx-repo"
	help
	  Prebuilt RPM packages location

config SUBSYSTEM_COMPONENT_ROOTFS_PACKAGE_REPO_URL1
	string "rootfs package feed url1"
	depends on SUBSYSTEM_COMPONENT_ROOTFS_PACKAGE_REPO_URL0 != ""
	default ""
	help
	  Prebuilt RPM packages location.
	  It has higher priority than the previous repo url.

config SUBSYSTEM_COMPONENT_ROOTFS_PACKAGE_REPO_URL2
	string "rootfs package feed url2"
	depends on SUBSYSTEM_COMPONENT_ROOTFS_PACKAGE_REPO_URL1 != ""
	default ""
	help
	  Prebuilt RPM packages location.
	  It has higher priority than the previous repo url.

config SUBSYSTEM_COMPONENT_ROOTFS_PACKAGE_REPO_URL3
	string "rootfs package feed url3"
	depends on SUBSYSTEM_COMPONENT_ROOTFS_PACKAGE_REPO_URL2 != ""
	default ""
	help
	  Prebuilt RPM packages location.
	  It has higher priority than the previous repo url.

menu "Generic Components"
endmenu
endmenu
menu "Auto Config Settings"
config SUBSYSTEM_AUTOCONFIG_DEVICE__TREE
	bool "Device tree autoconfig"
	default y
	select SUBSYSTEM_HARDWARE_AUTO
	help
	  Select this option to enable auto subsystem/linux/hw-description
	  system.dtsi generation.

config SUBSYSTEM_DEVICE_TREE_MANUAL_INCLUDE
	bool "Specify a manual device tree include directory"
	default n
	help
	  Select this option to allow you to specify a custom include directory
	  to use when compiling the device tree.

config SUBSYSTEM_DEVICE_TREE_INCLUDE_DIR
	string "Manual device tree include directory"
	default ""
	depends on SUBSYSTEM_DEVICE_TREE_MANUAL_INCLUDE
	help
	  This is the include directory used by DTC during device tree compliation.

config SUBSYSTEM_DEVICE_TREE_INCLUDE_DIR
	string "Automatic device tree include directory (NO EDIT)"
	default ""
	depends on !SUBSYSTEM_DEVICE_TREE_MANUAL_INCLUDE
	help
	  This is the include directory used by DTC during device tree compliation.
	  This is automatically generated

config SUBSYSTEM_AUTOCONFIG_KERNEL
	bool "kernel autoconfig"
	default y
	help
	  Select this option to allow PetaLiux to modify Kernel config based on
	  system config.

config SUBSYSTEM_AUTOCONFIG_ROOTFS
	bool "rootfs autoconfig"
	default y
	help
	  Select this option to allow PetaLiux to modify Kernel config based on
	  system config.

config SUBSYSTEM_AUTOCONFIG_U__BOOT
	bool "u-boot autoconfig"
	default y
	select SUBSYSTEM_HARDWARE_AUTO
	help
	  Select this option to enable auto u-boot configuration.

endmenu

source /home/yunwu/workspaces/gitworkspace/arty-z7/Arty-Z7-20-Petalinux-boot-from-ext4/Digilent-Arty-Z7-Linux-BD-v2016.2/build/linux/Kconfig.syshw

if !SUBSYSTEM_HARDWARE_AUTO
choice
	prompt "System Architecture"
	default SUBSYSTEM_ARCH_ARM

config SUBSYSTEM_ARCH_AARCH64
	bool "aarch64"
	help
	  Choose this option to specify AARCH64 as the SUBSYSTEM architecture

config SUBSYSTEM_ARCH_ARM
	bool "arm"
	help
	  Choose this option to specify ARM as the SUBSYSTEM architecture

config SUBSYSTEM_ARCH_MICROBLAZE
	bool "microblaze"
	help
	  Choose this option to specify MicroBlaze as the SUBSYSTEM architecture
endchoice
endif


config SUBSYSTEM_ENDIAN_LITTLE
	bool
	default y

if SUBSYSTEM_AUTOCONFIG_DEVICE__TREE
menu "Kernel Bootargs"
config SUBSYSTEM_BOOTARGS_AUTO
	bool "generate boot args automatically"
	default y
	depends on !SUBSYSTEM_SERIAL_MANUAL_SELECT

config SUBSYSTEM_USER_CMDLINE
	string "user set kernel bootargs"
	default ""
	depends on !SUBSYSTEM_BOOTARGS_AUTO
	help
	  Specify any commandline arguments you wish to pass to the kernel
	  at boot.

config SUBSYSTEM_BOOTARGS_EARLYPRINTK
	bool "enable kernel earlyprintk"
	default y
	depends on SUBSYSTEM_BOOTARGS_AUTO
	help
	  Select this option to enable kernel earlyprintk.

config SUBSYSTEM_BOOTARGS_GENERATED
	string "Auto generated bootargs (NO EDIT!)"
	default ""
	depends on SUBSYSTEM_BOOTARGS_AUTO
	help
	  system auto generated bootargs.
	  WARNING: Do not edit, your chagnes will be lost.

endmenu
endif

if SUBSYSTEM_ARCH_AARCH64 && !SUBSYSTEM_COMPONENT_ARM__TRUSTED__FIRMWARE_NAME_NONE
menu "ARM Trusted Firmware Compilation Configuration"
config SUBSYSTEM_ATF_COMPILE_EXTRA_SETTINGS
	string "extra ATF compilation settings"
	default ""
	help
	  Extra ATF compilation Settings. You and put multiple settings there,
	  seperated with semicolon.
	  E.g. MAKEARCH+=RESET_TO_BL31=1 SPD=tspd; ATF_BUILD_TARGET=bl31 bl32
config SUBSYSTEM_ZYNQMP_ATF_MEM_BASE
	hex "ZynqMP ATF MEM BASE"
	default 0xfffe5000
	help
	  On default the ATF is placed in OCM memory. Alternatively, the ATF can be
	  placed in DRAM by updating ZynqMP_ATF_MEM_BASE and ZynqMP_ATF_MEM_SIZE.
config SUBSYSTEM_ZYNQMP_ATF_MEM_SIZE
	hex "ZynqMP ATF MEM SIZE"
	default 0x1b000
	help
	  Mention the ATF size.

endmenu
endif

if !SUBSYSTEM_COMPONENT_U__BOOT_NAME_NONE
menu "u-boot Configuration"
	choice
	prompt "U-boot config"
	default SUBSYSTEM_UBOOT_CONFIG_PETALINUX

config SUBSYSTEM_UBOOT_CONFIG_PETALINUX
	bool "PetaLinux u-boot config"
	help
	  Choose this option to use PetaLinux u-boot configuration

config SUBSYSTEM_UBOOT_CONFIG_OTHER
	bool "other"
	help
	  Choose this option to specify other u-boot config
endchoice

config SUBSYSTEM_UBOOT_CONFIG_TARGET
	string "u-boot config target"
	depends on SUBSYSTEM_UBOOT_CONFIG_OTHER
	help
	  Specify a u-boot config target when building u-boot, it will run 
	  run u-boot XXX config target: make XXX_config to configure u-boot
	  first.

if SUBSYSTEM_AUTOCONFIG_U__BOOT && SUBSYSTEM_UBOOT_CONFIG_PETALINUX
	config SUBSYSTEM_NETBOOT_OFFSET
	hex "netboot offset"
	default 0x1000000
	help
	 Set this to define the memory offset to load the image of netboot command in u-boot.

	config SUBSYSTEM_U__BOOT_TFTPSERVER_IP
	string "TFTP Server IP address"
	default "AUTO"
	help
	 The IP address of your TFTP file server in the main network interface.

	 Specify the special value "AUTO" to use the IP address of your
	 development host.

endif
endmenu
endif

menu "Image Packaging Configuration"
choice
	prompt "Root filesystem type"
	default SUBSYSTEM_ROOTFS_INITRAMFS

config SUBSYSTEM_ROOTFS_INITRAMFS
	bool "INITRAMFS"
	help
	  Choose this option to configure your PetaLinux build to use
	  the kernel INITRAMFS mechanism for the root filesystem.

	  The root filesystem will be writeable, but not persistent,
	  meaning that any changes are lost upon reboot.

config SUBSYSTEM_ROOTFS_INITRD
	bool "INITRD"
	help
	  Choose this opion to configure your PetaLinux build to use
	  kernel INITRD mechinsm for the root filesystem.

config SUBSYSTEM_ROOTFS_JFFS2
	bool "JFFS2"
	help
	  Choose this option to configure your PetaLinux build for the
	  root filesystem to be mounted on a JFFS2 flash partition.

	  You must also ensure that your Flash Partition Table (see below)
	  contains a partition named "jffs2" and is of a suitable size.

config SUBSYSTEM_ROOTFS_NFS
	bool "NFS"
	help
	  Choose this setting to configure your PetaLinux build for NFS Root.

	  Your workstation must be properly configured for NFS, and the
	  NFS root directory (see below) must be exported properly.

config SUBSYSTEM_ROOTFS_SD
	bool "SD card"
	help
	  Choose this setting to configure your PetaLinux build for SD Root.

config SUBSYSTEM_ROOTFS_OTHER
	bool "other"
	help
	  Choose this setting to configure your PetaLinux build for other root.

	  You will need to manually generate the Root FS image.

endchoice

choice
	prompt "jffs2 erase block size(KByte)"
	default SUBSYSTEM_JFFS2_ERASE_SIZE_64
	depends on SUBSYSTEM_ROOTFS_JFFS2
config SUBSYSTEM_JFFS2_ERASE_SIZE_16
	bool "jffs2 erase block size: 16KiB"
config SUBSYSTEM_JFFS2_ERASE_SIZE_32
	bool "jffs2 erase block size: 32KiB"
config SUBSYSTEM_JFFS2_ERASE_SIZE_64
	bool "jffs2 erase block size: 64KiB"
config SUBSYSTEM_JFFS2_ERASE_SIZE_128
	bool "jffs2 erase block size: 128KiB"
config SUBSYSTEM_JFFS2_ERASE_SIZE_256
	bool "jffs2 erase block size: 256KiB"
config SUBSYSTEM_JFFS2_ERASE_SIZE_512
	 bool "jffs2 erase block size: 512KiB"
endchoice

config SUBSYSTEM_NFSROOT_DIR
	string "Location of NFS root directory"
	depends on SUBSYSTEM_ROOTFS_NFS
	default "/tftpboot/nfsroot"

config SUBSYSTEM_NFSSERVER_IP
	string "NFS Server IP address"
	default "AUTO"
	depends on SUBSYSTEM_ROOTFS_NFS
	help
	 The IP address of your NFS server in the main network interface.

config SUBSYSTEM_SDROOT_DEV
	string "Device node of SD device"
	depends on SUBSYSTEM_ROOTFS_SD
	default "/dev/mmcblk0p2"

config SUBSYSTEM_INITRD_RAMDISK_LOADADDR
	hex "RAMDISK loadaddr"
	default "0x0"
	depends on SUBSYSTEM_ROOTFS_INITRD
	help
	  RAMDISK Load address if INITRD is selected as rootfs type

config SUBSYSTEM_RAMDISK_IMAGE
	string "Location of ramdisk image"
	depends on SUBSYSTEM_ROOTFS_INITRD
	default "${PROOT}/images/${SUBSYSTEM}/rootfs.cpio.gz"

config SUBSYSTEM_UIMAGE_NAME
	string "name for bootable kernel image"
	default "image.ub"
	help
	  Specify the name of uboot bootable kernel image

choice
	prompt "Kernel image HASH checking"
	default SUBSYSTEM_UIMAGE_HASH_CRC32

config SUBSYSTEM_UIMAGE_HASH_NONE
	bool "none"
	help
	  Disable hash checking
config SUBSYSTEM_UIMAGE_HASH_CRC32
	bool "crc32"
	help
	  Enable crc32 hash checking
config SUBSYSTEM_UIMAGE_HASH_SHA1
	bool "sha1"
	help
	  Enable sha1 hash checking
config SUBSYSTEM_UIMAGE_HASH_BOTH
	bool "both"
	help
	  Enable both crc32 and sha1 hash checking

endchoice

config SUBSYSTEM_COMPRESS_IMAGE
	bool "Compress kernel image"
	default y
	help
	 Set this if you would like to compress the u-boot bootable kernel
	 image.

config SUBSYSTEM_DTB_PADDING_SIZE
	hex "DTB padding size"
	default 0x1000
	help
	  Set this value for DTB padding size

config SUBSYSTEM_COPY_TO_TFTPBOOT
	bool "Copy final images to tftpboot"
	help
	  Set this if you would like the final build image to be automatically
	  copied to your TFTP server directory.

config SUBSYSTEM_TFTPBOOT_DIR
	string "tftpboot directory"
	depends on SUBSYSTEM_COPY_TO_TFTPBOOT
	default "/tftpboot"
	help
	  The directory that your TFTP server serves its files from.
endmenu

menu "Firmware Version Configuration"
config SUBSYSTEM_HOSTNAME
	string "Host name"
	default "petalinux"
	help
	 The host name of your SUBSYSTEM, set at startup.

config SUBSYSTEM_PRODUCT
	string "Product name"
	default ""
	help
	  This is an string inserted into /etc/product during the build.

config SUBSYSTEM_FW_VERSION
	string "Firmware Version"
	default "1.00"
	help
	  This is an arbitrary string value that is inserted into
	  /etc/version during the build.
endmenu
```
