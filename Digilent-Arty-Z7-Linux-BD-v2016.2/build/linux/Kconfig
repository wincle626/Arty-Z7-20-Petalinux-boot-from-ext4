## Digilent-Arty-Z7-Linux-BD-v2016.2/build/linux/rootfs/Kconfig
```kconfig
mainmenu "linux/rootfs Configuration"
config ARCH_ARM
	bool
	default y
menu "Filesystem Packages"
source "/home/yunwu/workspaces/gitworkspace/arty-z7/Arty-Z7-20-Petalinux-boot-from-ext4/Digilent-Arty-Z7-Linux-BD-v2016.2/build/linux/rootfs/packages-repo/Kconfig.pkgs.default"
source "/home/yunwu/workspaces/gitworkspace/arty-z7/Arty-Z7-20-Petalinux-boot-from-ext4/Digilent-Arty-Z7-Linux-BD-v2016.2/build/linux/rootfs/packages-repo/Kconfig.pkgs"
endmenu
menu "Libs"
endmenu
menu "Apps"
menuconfig ROOTFS_COMPONENT_APPS_NAME_CONSOLE__BLANK
	bool "console-blank"
source /home/yunwu/workspaces/gitworkspace/arty-z7/Arty-Z7-20-Petalinux-boot-from-ext4/Digilent-Arty-Z7-Linux-BD-v2016.2/components//apps/console-blank/Kconfig
menuconfig ROOTFS_COMPONENT_APPS_NAME_FWUPGRADE
	bool "fwupgrade"
source /opt/petalinux/petalinux-v2016.2-final/components//apps/fwupgrade/Kconfig
menuconfig ROOTFS_COMPONENT_APPS_NAME_GPIO__DEMO
	bool "gpio-demo"
source /opt/petalinux/petalinux-v2016.2-final/components//apps/gpio-demo/Kconfig
menuconfig ROOTFS_COMPONENT_APPS_NAME_INITTAB_CUSTOMISATION
	bool "inittab_customisation"
source /home/yunwu/workspaces/gitworkspace/arty-z7/Arty-Z7-20-Petalinux-boot-from-ext4/Digilent-Arty-Z7-Linux-BD-v2016.2/components//apps/inittab_customisation/Kconfig
menuconfig ROOTFS_COMPONENT_APPS_NAME_LATENCYSTAT
	bool "latencystat"
source /opt/petalinux/petalinux-v2016.2-final/components//apps/latencystat/Kconfig
menuconfig ROOTFS_COMPONENT_APPS_NAME_PEEKPOKE
	bool "peekpoke"
source /opt/petalinux/petalinux-v2016.2-final/components//apps/peekpoke/Kconfig
endmenu
menu "Modules"
endmenu
menu "PetaLinux RootFS Settings"
config ROOTFS_ROOT_PASSWD
	string "Root password"
	default ""
	help
	  Default login password for the 'root' user, on your PetaLinux system.

comment "Service configuration"
config ROOTFS_BUSYBOX_INETD_FTPD
	bool "Enable busybox FTPD with inetd service"
	select ROOTFS_PACKAGES_BUSYBOX_INETD
	default 'y'
	help
	 Select this option to enable busybox ftpd with inetd service and
	 run it on startup.

config ROOTFS_BUSYBOX_INETD_TELNETD
	bool "Enable busybox TELNETD with inetd service"
	select ROOTFS_PACKAGES_BUSYBOX_INETD
	default 'y'
	help
	 Select this option to enable busybox telnetd with inetd
	 service and run it on startup.
endmenu

#############################################################################

menu "Debugging"

config USER_DEBUG
	bool "build debugable applications"
	help
	 Build all user application with debug symbols and reduced optimisation
	 levels.  See also debug build option in force library building.  Withou
	 this option debug symbols are still included, however the optimisation
	 level is increased and this can lead to problematic debugging.

endmenu
```

## Digilent-Arty-Z7-Linux-BD-v2016.2/build/linux/rootfs/apps/fwupgrade/Kconfig
```kconfig
###############################################################################
# Please modify this file if you want to configure your own application.
# You can uncommon and/or change the following Kconfig elements.
###############################################################################


if APPS_FWUPGRADE
	comment "No additional options for FW_UPGRADE"

 	config APPS_FW_UPGRADE_BUSBYBOX
	def_bool y
	depends on PACKAGES_BUSYBOX
#	help
#	  Help text
endif
```

## Digilent-Arty-Z7-Linux-BD-v2016.2/build/linux/rootfs/packages-repo/Kconfig.pkgs.default
```kconfig
 config ROOTFS_BASE_SYSTEM_DEFAULT
	bool "base-system-default"
	select ROOTFS_PACKAGES_BASE_FILES
	select ROOTFS_PACKAGES_BASE_PASSWD
	select ROOTFS_PACKAGES_BUSYBOX
	select ROOTFS_PACKAGES_BUSYBOX_HWCLOCK
	select ROOTFS_PACKAGES_BUSYBOX_MDEV
	select ROOTFS_PACKAGES_INIT_IFUPDOWN
	select ROOTFS_PACKAGES_INITSCRIPTS
	select ROOTFS_PACKAGES_INITSCRIPTS_FUNCTIONS
	select ROOTFS_PACKAGES_LIBC6
	select ROOTFS_PACKAGES_MODUTILS_INITSCRIPTS
	select ROOTFS_PACKAGES_NETBASE
	select ROOTFS_PACKAGES_SYSVINIT
	select ROOTFS_PACKAGES_SYSVINIT_INITTAB
	select ROOTFS_PACKAGES_SYSVINIT_PIDOF
	select ROOTFS_PACKAGES_UPDATE_ALTERNATIVES_OPKG
	select ROOTFS_PACKAGES_BUSYBOX_UDHCPC
	default y
	help
	 Base System Image
```

## build/linux/rootfs/Kconfig.part
```kconfig
menu "PetaLinux RootFS Settings"
config ROOTFS_ROOT_PASSWD
	string "Root password"
	default ""
	help
	  Default login password for the 'root' user, on your PetaLinux system.

comment "Service configuration"
config ROOTFS_BUSYBOX_INETD_FTPD
	bool "Enable busybox FTPD with inetd service"
	select ROOTFS_PACKAGES_BUSYBOX_INETD
	default 'y'
	help
	 Select this option to enable busybox ftpd with inetd service and
	 run it on startup.

config ROOTFS_BUSYBOX_INETD_TELNETD
	bool "Enable busybox TELNETD with inetd service"
	select ROOTFS_PACKAGES_BUSYBOX_INETD
	default 'y'
	help
	 Select this option to enable busybox telnetd with inetd
	 service and run it on startup.
endmenu

#############################################################################

menu "Debugging"

config USER_DEBUG
	bool "build debugable applications"
	help
	 Build all user application with debug symbols and reduced optimisation
	 levels.  See also debug build option in force library building.  Withou
	 this option debug symbols are still included, however the optimisation
	 level is increased and this can lead to problematic debugging.

endmenu
```
